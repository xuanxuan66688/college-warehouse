#include "OLED.h"
#include "i2c.h"

const uint8_t OLED_Font[10][16] = {
    {0x00,0x7E,0x41,0x41,0x41,0x7E,0x00,0x00,0x00,0x7F,0x40,0x40,0x40,0x7F,0x00,0x00},
    {0x00,0x04,0x02,0x7F,0x00,0x00,0x00,0x00,0x00,0x40,0x40,0x7F,0x40,0x40,0x00,0x00},
    {0x00,0x72,0x49,0x49,0x49,0x46,0x00,0x00,0x00,0x78,0x41,0x40,0x40,0x79,0x00,0x00},
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    {0x00,0x46,0x49,0x49,0x49,0x7E,0x00,0x00,0x00,0x41,0x49,0x49,0x49,0x7F,0x00,0x00},
};

static void OLED_WriteCmd(uint8_t cmd)
{
    uint8_t buf[2] = {0x00, cmd};
    HAL_I2C_Master_Transmit(&hi2c1, 0x3C<<1, buf, 2, 100);
}

static void OLED_WriteData(uint8_t data)
{
    uint8_t buf[2] = {0x40, data};
    HAL_I2C_Master_Transmit(&hi2c1, 0x3C<<1, buf, 2, 100);
}

static void OLED_SetPos(uint8_t x, uint8_t page)
{
    OLED_WriteCmd(0xb0 + page);
    OLED_WriteCmd(x & 0x0F);
    OLED_WriteCmd(0x10 | ((x>>4)&0x0F));
}

void OLED_CLS(void)
{
    uint8_t i,j;
    for(j=0;j<8;j++)
    {
        OLED_WriteCmd(0xb0+j);
        OLED_WriteCmd(0x00);
        OLED_WriteCmd(0x10);
        for(i=0;i<128;i++)
            OLED_WriteData(0x00);
    }
}

void OLED_Init(void)
{
    HAL_Delay(100);

    OLED_WriteCmd(0xAE);
    OLED_WriteCmd(0xD5); OLED_WriteCmd(0x80);
    OLED_WriteCmd(0xA8); OLED_WriteCmd(0x3F);
    OLED_WriteCmd(0xD3); OLED_WriteCmd(0x00);
    OLED_WriteCmd(0x40);
    OLED_WriteCmd(0x8D); OLED_WriteCmd(0x14);
    OLED_WriteCmd(0x20); OLED_WriteCmd(0x02);
    OLED_WriteCmd(0xA1);
    OLED_WriteCmd(0xC8);
    OLED_WriteCmd(0xDA); OLED_WriteCmd(0x12);
    OLED_WriteCmd(0x81); OLED_WriteCmd(0xCF);
    OLED_WriteCmd(0xD9); OLED_WriteCmd(0xF1);
    OLED_WriteCmd(0xDB); OLED_WriteCmd(0x30);
    OLED_WriteCmd(0xA4);
    OLED_WriteCmd(0xA6);
    OLED_WriteCmd(0xAF);

    OLED_CLS();
}
static void OLED_ShowChar(uint8_t x, uint8_t page, uint8_t num)
{
    uint8_t i;
    if(num>9) return;

    OLED_SetPos(x, page);
    for(i=0;i<8;i++)
        OLED_WriteData(OLED_Font[num][i]);

    OLED_SetPos(x, page+1);
    for(i=8;i<16;i++)
        OLED_WriteData(OLED_Font[num][i]);
}

void OLED_ShowNum(uint8_t x, uint8_t page, int num)
{
    if(num < 0) num = -num;

    if(num >= 10000)
        OLED_ShowChar(x+0*8, page, num/10000);
    if(num >= 1000)
        OLED_ShowChar(x+1*8, page, (num%10000)/1000);
    if(num >= 100)
        OLED_ShowChar(x+2*8, page, (num%1000)/100);
    if(num >= 10)
        OLED_ShowChar(x+3*8, page, (num%100)/10);

    OLED_ShowChar(x+4*8, page, num%10);
}